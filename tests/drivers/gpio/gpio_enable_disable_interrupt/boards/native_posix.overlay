/*
 * Copyright (c) 2022 Google Inc
 *
 * SPDX-License-Identifier: Apache-2.0
 */

/ {
	resources {
		compatible = "test-gpio-enable-disable-interrupt";
		in-gpios = <&gpio0 0 0>; /* Pin 0 */
	};
};

&gpio0 {
	ngpios = <1>;
};
